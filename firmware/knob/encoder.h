#pragma once

#include <Arduino.h>
#include <driver/spi_master.h>

// Pin map, SPI timing and CRC polynomial follow LILYGO's
// T-Knob/examples/2_encoder_mt6701. No motor control is performed here.
// This class hides the sensor's byte-level communication from main.cpp:
// begin() configures it once; read() returns a raw angle or reports failure.
class Encoder {
 public:
  void begin() {
    // SPI uses a clock (SCLK), chip select (CS), and data lines. Here the MCU
    // only reads: MISO carries sensor -> MCU data and MOSI is unused (-1).
    // {} initializes the configuration before we assign the required fields.
    spi_bus_config_t bus = {};
    bus.mosi_io_num = -1;
    bus.miso_io_num = 15;
    bus.sclk_io_num = 14;
    // Quad-SPI's extra data lines are unused for this sensor.
    bus.quadwp_io_num = -1;
    bus.quadhd_io_num = -1;
    // SPI2_HOST is the hardware SPI controller. DMA_CH_AUTO asks the driver to
    // choose a DMA channel (direct memory access). ESP_ERROR_CHECK stops with a
    // diagnostic on setup failure rather than continuing with an unusable bus.
    ESP_ERROR_CHECK(spi_bus_initialize(SPI2_HOST, &bus, SPI_DMA_CH_AUTO));

    // A bus may host multiple devices; this configuration describes our sensor.
    // SPI mode controls clock polarity/phase. Use the vendor's mode and timing,
    // a 4 MHz clock, GPIO 7 for CS, and room for one queued transaction.
    spi_device_interface_config_t device = {};
    device.mode = 1;
    device.cs_ena_pretrans = 4;
    device.clock_speed_hz = 4000000;
    device.spics_io_num = 7;
    device.queue_size = 1;
    ESP_ERROR_CHECK(spi_bus_add_device(SPI2_HOST, &device, &device_));
  }

  bool read(uint16_t &angle) {
    // & makes angle an output reference: assigning it below updates the caller's
    // variable. On failure we return false without writing a new angle.
    spi_transaction_t transaction = {};
    // A three-byte reply fits inside the transaction's own rx_data array, so
    // no separate receive buffer is needed. Driver lengths are in bits, not bytes.
    transaction.flags = SPI_TRANS_USE_RXDATA;
    transaction.length = 24;
    transaction.rxlength = 24;
    // CS and clocks are generated by the SPI peripheral. "Polling" means this
    // function waits for the short transfer to finish before examining its bytes.
    if (spi_device_polling_transmit(device_, &transaction) != ESP_OK) {
      return false;
    }
    // Assemble the sensor's three bytes into a 24-bit value, first byte highest.
    // Cast to 32 bits before shifting. << moves bits and | joins the bit fields.
    const uint32_t frame = (uint32_t(transaction.rx_data[0]) << 16) |
                           (uint32_t(transaction.rx_data[1]) << 8) |
                           transaction.rx_data[2];
    // CRC-6, polynomial x^6 + x + 1, over the upper 18 bits.
    // A CRC is an error-detection checksum, not encryption. Recompute it from
    // the received angle/status bits, then compare with the six transmitted CRC
    // bits. A mismatch means this reading should not be used for movement.
    uint8_t crc = 0;
    for (int bit = 23; bit >= 6; --bit) {
      // Process one input bit at a time. ^ is XOR; & 1 extracts one bit and
      // & 0x3f keeps the running remainder within six bits (binary 111111).
      const bool feedback = ((crc >> 5) ^ (frame >> bit)) & 1;
      crc = (crc << 1) & 0x3f;
      if (feedback) crc ^= 0x03;
    }
    if (crc != (frame & 0x3f)) return false;
    // Bits 23..10 hold the 14-bit absolute angle. Shifting drops the four
    // status bits and six CRC bits; main.cpp converts the count into degrees.
    angle = frame >> 10;
    return true;
  }

 private:
  // The driver fills this handle in begin(). It identifies the configured SPI
  // device for future transactions; it is not the angle or a GPIO number.
  spi_device_handle_t device_ = nullptr;
};
